AUTOSAR XML (schema 4-2-2)
standard types defined: Boolean, Uint8, Uint16, Uint32, Sint16
package /DataTypes/ImplementationTypes
  13 x impl type:
    t_Temperature: compu {phys=raw*0.1-40 for raw -80..120; unit DegreeC}, range raw -80..120, implementation-data-type=Sint16, unit=DegreeC
    t_VehicleSpeed: compu {phys=raw*0.05625 for raw 0..240; unit Kmperh}, range raw 0..240, implementation-data-type=Sint16, unit=Kmperh
    t_UsageMode: compu {0=E_USGMODST_STANDBY, 3=E_USGMODST_COMFORT, 5=E_USGMODST_TOBEDRV, 7=E_USGMODST_DRV, 12=E_USGMODST_NOTUSED}, range raw 0..12, implementation-data-type=Uint8
    t_BatteryMode: compu {0=E_BATMODE_OFF, 1=E_BATMODE_IG, 2=E_BATMODE_ON}, range raw 0..2, implementation-data-type=Uint8
    t_HvacCtrReturn: compu {0=E_HVACCTR_ACCEPT, 1=E_HVACCTR_PARAMERROR, 2=E_HVACCTR_MODEERROR}, range raw 0..2, implementation-data-type=Uint8
    t_HvacOnOff: compu {0=E_HVACSW_NONE, 1=E_HVACSW_ON, 2=E_HVACSW_0FF}, range raw 0..2, implementation-data-type=Uint8
    t_HvacOperationMode: compu {0=E_HVACOP_NONE, 1=E_HVACOP_DEMIST, 2=E_HVACOP_HEAT, 3=E_HVACOP_REFRIG, 4=E_HVACOP_AUTO}, range raw 0..4, implementation-data-type=Uint8
    t_HvacCirculationMode: compu {0=E_HVACCIRC_NONE, 1=E_HVACCIRC_INT, 2=E_HVACCIRC_EXT}, range raw 0..2, implementation-data-type=Uint8
    t_HvacFanCtrMode: compu {0=E_HVACFANCTR_NONE, 1=E_HVACFANCTR_FACE, 2=E_HVACFANCTR_UP, 3=E_HVACFANCTR_DOWN}, range raw 0..3, implementation-data-type=Uint8
    t_MotorCtrCmd: compu {0=E_MOTORCTRCMD_NONE, 1=E_MOTORCTRCMD_OPEN, 2=E_MOTORCTRCMD_CLOSE}, range raw 0..2, implementation-data-type=Uint8
    t_MotorCtrErr: compu {0=E_MOTORCTRERR_ACCEPT, 1=E_MOTORCTRERR_DENIED}, range raw 0..1, implementation-data-type=Uint8
    t_MotorErr: category=STRUCTURE
      element OpenLoad: implementation-data-type=Boolean
      element Short2GND: implementation-data-type=Boolean
      element Short2BAT: implementation-data-type=Boolean
    t_VehicleMode: category=STRUCTURE
      element UsageMode: implementation-data-type=t_UsageMode
      element BatteryMode: implementation-data-type=t_BatteryMode
package /DataTypes/Units
  unit DegreeC: display-name=DegreeC
  unit Kmperh: display-name=Kmperh
package /PortInterfaces
  4 x sender receiver interface:
    VehicleConditions
      data FunctionInhibit: type=Boolean
      data MotorErrFlag: type=Boolean
      data SpeedLimited: type=Boolean
    MotorErr
      data LeftMotor: type=t_MotorErr
      data RightMotor: type=t_MotorErr
    VehicleMode
      data Data: type=t_VehicleMode
    GeneralInterface
      data Status: type=Boolean
  client server interface CockpitService
    4 x operation, all with possible-error=[CockpitService/E_OK, CockpitService/E_NOT_OK]:
      GetAmbientTemp
        arg Data: type=t_Temperature, direction=OUT, server-argument-impl-policy=USE-ARGUMENT-TYPE
      GetInteriorTemp
        arg Data: type=t_Temperature, direction=OUT, server-argument-impl-policy=USE-ARGUMENT-TYPE
      SetHvacCtrl
        6 x arg, all with server-argument-impl-policy=USE-ARGUMENT-TYPE:
          OnOff: type=t_HvacOnOff, direction=IN
          OperationMode: type=t_HvacOperationMode, direction=IN
          CirculationMode: type=t_HvacCirculationMode, direction=IN
          FanCtrMode: type=t_HvacFanCtrMode, direction=IN
          TargetTemp: type=t_Temperature, direction=IN
          ReturnCode: type=t_HvacCtrReturn, direction=OUT
      RefreshRequest
    error E_OK: error-code=0
    error E_NOT_OK: error-code=1
  client server interface MotorCtrService
    operation MoveRequest: possible-error=[MotorCtrService/E_OK, E_MOTOR_APPERROR]
      arg Cmd: type=t_MotorCtrCmd, direction=IN, server-argument-impl-policy=USE-ARGUMENT-TYPE
      arg Result: type=t_MotorCtrErr, direction=OUT, server-argument-impl-policy=USE-ARGUMENT-TYPE
    operation lastStopReason: possible-error=[MotorCtrService/E_OK, E_MOTOR_APPERROR]
      arg Result: type=Uint8, direction=OUT, server-argument-impl-policy=USE-ARGUMENT-TYPE
    operation MotorRunning: possible-error=[MotorCtrService/E_OK, E_MOTOR_APPERROR]
      arg Flag: type=Boolean, direction=INOUT, server-argument-impl-policy=USE-ARGUMENT-TYPE
    error E_OK: error-code=0
    error E_MOTOR_APPERROR: error-code=1
  client server interface DoorLockService
    operation LockRequest: possible-error=[DoorLockService/E_OK, DoorLockService/E_NOT_OK]
      arg Cmd: type=Uint8, direction=IN, server-argument-impl-policy=USE-ARGUMENT-TYPE
      arg Result: type=Uint8, direction=OUT, server-argument-impl-policy=USE-ARGUMENT-TYPE
    operation GetDoorStatus: possible-error=[DoorLockService/E_OK, DoorLockService/E_NOT_OK]
      arg Result: type=Uint8, direction=OUT, server-argument-impl-policy=USE-ARGUMENT-TYPE
    operation LookUpDoorCfg: possible-error=[DoorLockService/E_OK, DoorLockService/E_NOT_OK]
      arg IndexResult: type=Uint8, direction=INOUT, server-argument-impl-policy=USE-ARGUMENT-TYPE
      arg ErrCode: type=Uint8, direction=OUT, server-argument-impl-policy=USE-ARGUMENT-TYPE
    error E_OK: error-code=0
    error E_NOT_OK: error-code=1
