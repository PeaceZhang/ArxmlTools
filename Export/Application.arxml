AUTOSAR XML (schema 4-2-2)
standard types defined: Boolean, Uint8, Uint16, Uint32, Sint16
package /DataTypes/ImplementationTypes
  14 x impl type:
    t_Temperature: compu {phys=raw*0.1-40 for raw -80..120; unit DegreeC}, range raw -80..120, implementation-data-type=Sint16, unit=DegreeC
    t_VehicleSpeed: compu {phys=raw*0.05625 for raw 0..240; unit Kmperh}, range raw 0..240, implementation-data-type=Sint16, unit=Kmperh
    t_UsageMode: compu {0=E_USGMODST_STANDBY, 3=E_USGMODST_COMFORT, 5=E_USGMODST_TOBEDRV, 7=E_USGMODST_DRV, 12=E_USGMODST_NOTUSED}, range raw 0..12, implementation-data-type=Uint8
    t_BatteryMode: compu {0=E_BATMODE_OFF, 1=E_BATMODE_IG, 2=E_BATMODE_ON}, range raw 0..2, implementation-data-type=Uint8
    t_StdReturn: compu {0=E_OK, 1=E_NOT_OK}, range raw 0..1, implementation-data-type=Uint8
    t_HvacCtrReturn: compu {0=E_HVACCTR_ACCEPT, 1=E_HVACCTR_PARAMERROR, 2=E_HVACCTR_MODEERROR}, range raw 0..2, implementation-data-type=Uint8
    t_HvacOnOff: compu {0=E_HVACSW_NONE, 1=E_HVACSW_ON, 2=E_HVACSW_0FF}, range raw 0..2, implementation-data-type=Uint8
    t_HvacOperationMode: compu {0=E_HVACOP_NONE, 1=E_HVACOP_DEMIST, 2=E_HVACOP_HEAT, 3=E_HVACOP_REFRIG, 4=E_HVACOP_AUTO}, range raw 0..4, implementation-data-type=Uint8
    t_HvacCirculationMode: compu {0=E_HVACCIRC_NONE, 1=E_HVACCIRC_INT, 2=E_HVACCIRC_EXT}, range raw 0..2, implementation-data-type=Uint8
    t_HvacFanCtrMode: compu {0=E_HVACFANCTR_NONE, 1=E_HVACFANCTR_FACE, 2=E_HVACFANCTR_UP, 3=E_HVACFANCTR_DOWN}, range raw 0..3, implementation-data-type=Uint8
    t_MotorCtrCmd: compu {0=E_MOTORCTRCMD_NONE, 1=E_MOTORCTRCMD_OPEN, 2=E_MOTORCTRCMD_CLOSE}, range raw 0..2, implementation-data-type=Uint8
    t_MotorCtrErr: compu {0=E_MOTORCTRERR_ACCEPT, 1=E_MOTORCTRERR_DENIED}, range raw 0..1, implementation-data-type=Uint8
    t_MotorErr: category=STRUCTURE
      element OpenLoad: implementation-data-type=Boolean
      element Short2GND: implementation-data-type=Boolean
      element Short2BAT: implementation-data-type=Boolean
    t_VehicleMode: category=STRUCTURE
      element UsageMode: implementation-data-type=t_UsageMode
      element BatteryMode: implementation-data-type=t_BatteryMode
package /DataTypes/Units
  unit DegreeC: display-name=DegreeC
  unit Kmperh: display-name=Kmperh
