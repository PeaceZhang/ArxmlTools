AUTOSAR XML (schema 4-2-2)
standard types defined: Boolean, Uint8, Uint16, Uint32
package /DataTypes/ImplementationTypes
  4 x impl type:
    e_UsageMode: compu {0=E_USGMODST_STANDBY, 3=E_USGMODST_COMFORT, 5=E_USGMODST_TOBEDRV, 7=E_USGMODST_DRV, 12=E_USGMODST_NOTUSED}, range raw 0..12, implementation-data-type=Uint8
    e_BatteryMode: compu {0=E_BATMODE_OFF, 1=E_BATMODE_IG, 2=E_BATMODE_ON}, range raw 0..2, implementation-data-type=Uint8
    t_MotorErr: category=STRUCTURE
      element OpenLoad: implementation-data-type=Boolean
      element Short2GND: implementation-data-type=Boolean
      element Short2BAT: implementation-data-type=Boolean
    t_VehicleMode: category=STRUCTURE
      element UsageMode: implementation-data-type=e_UsageMode
      element BatteryMode: implementation-data-type=e_BatteryMode
package /PortInterfaces
  4 x sender receiver interface:
    VehicleConditions
      data FunctionInhibit: type=Boolean
      data MotorErrFlag: type=Boolean
      data SpeedLimited: type=Boolean
    MotorErr
      data LeftMotor: type=t_MotorErr
      data RightMotor: type=t_MotorErr
    VehicleMode
      data Data: type=t_VehicleMode
    GeneralInterface
      data Status: type=Boolean
